## config/boards/shields/AroundForty/Kconfig.shield
```kconfig
config SHIELD_AROUNDFORTY_R
    def_bool $(shields_list_contains,AroundForty_R)

config SHIELD_AROUNDFORTY_L
    def_bool $(shields_list_contains,AroundForty_L)
```
